## arch/arm/mach-davinci/Kconfig
```kconfig
if ARCH_DAVINCI

menu "TI DaVinci Implementations"

comment "DaVinci Core Type"

config ARCH_DAVINCI644x
	default y
	bool "DaVinci 644x based system"

comment "DaVinci Board Type"

config MACH_DAVINCI_NTOSD_644XA
	bool "Neuros OSD (644x Revision A)"
	default n
	depends on ARCH_DAVINCI644x
	help
	  Configure this option to use Neuros OSD dm644x revision A
	  hardware.

config MACH_DAVINCI_EVM
	bool "TI DaVinci EVM"
	default y
	depends on ARCH_DAVINCI644x
	select GPIOEXPANDER_DAVINCI
	help
	  Configure this option to specify the whether the board used
	  for development is a DaVinci EVM

config DAVINCI_I2C_EXPANDER
	bool "TI DaVinci I2C Expander"
	default y
	depends on I2C && ARCH_DAVINCI644x
	help
	  Configure this option to specify whether the board used
	  has I2C exapnder with ATA, USB, CF.

config DAVINCI_MCBSP
	bool
        prompt "DaVinci McBSP Driver" if SOUND_DAVINCI=n
	depends on ARCH_DAVINCI
	default SOUND_DAVINCI
	---help---
	DaVinci McBSP driver.  Auto-enabled by DaVinci sound driver.

comment "DaVinci Options"

config DAVINCI_BLK_DEV_CF
	bool "TI DaVinci CF Card Support"
	default Y
	depends on BLK_DEV_DAVINCI
	help
	  Configure this option to enable CF Card support.

endmenu

endif
```

## drivers/net/wireless/rt73/Kconfig
```kconfig
config RT73
	tristate "Ralink RT73 chipset USB-wireless support"
	depends on USB && IEEE80211_SOFTMAC && MAC80211 && WLAN_80211 && EXPERIMENTAL
	select WIRELESS_EXT
	select FW_LOADER
	---help---
	  This is an experimental driver for the Ralink RT73 wireless
	  chip, present in many USB-wireless adapters.

	  Device firmware is required inside this driver: rt73.bin

config RT73_DEBUG
	bool "Ralink RT73 debugging"
	depends on RT73
	---help---
	  RT73 debugging messages. Choosing Y will result in additional debug
	  messages being saved to your kernel logs, which may help debug any
	  problems.
```

## drivers/video/dm/Kconfig
```kconfig
config FB_DM
        tristate "DM frame buffer support (EXPERIMENTAL)"
        depends on FB
	depends on VIDEO_OUTPUT_CONTROL
        help
          Frame buffer driver for DM644X based boards.
```
